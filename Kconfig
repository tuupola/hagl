## Kconfig
```kconfig
menu "Copepod graphics library"

config HAGL_TJPGD_NEEDS_BYTESWAP
    bool "Swap TJPGD output bytes"
    default y
    help
        If JPG file colours seems wrong change this setting.

endmenu
```
